## AjitPublicResources/tools/buildroot/AJIT_buildroot_configs/configs/AJIT_defconfig
```kconfig
BR2_sparc=y
BR2_DEFCONFIG="$(CONFIG_DIR)/defconfig"
BR2_PACKAGE_HOST_GDB=y
BR2_ROOTFS_DEVICE_CREATION_STATIC=y
BR2_ROOTFS_OVERLAY="$(BR2_EXTERNAL)/board/rootfs_overlay"
BR2_LINUX_KERNEL=y
BR2_LINUX_KERNEL_SAME_AS_HEADERS=y
BR2_LINUX_KERNEL_USE_CUSTOM_CONFIG=y
BR2_LINUX_KERNEL_CUSTOM_CONFIG_FILE="$(BR2_EXTERNAL)/board/AJIT_minimal_linux_kernel.config"
BR2_LINUX_KERNEL_VMLINUX=y
BR2_TARGET_ROOTFS_INITRAMFS=y
# BR2_TARGET_ROOTFS_TAR is not set
BR2_PACKAGE_HOST_E2FSPROGS=y
BR2_PACKAGE_HOST_GENEXT2FS=y
```

## from_ajit_repo/os/Ajit_linux/Ajit_buildroot_configs/configs/Ajit_defconfig
```kconfig
BR2_sparc=y
BR2_PACKAGE_HOST_GDB=y
BR2_ROOTFS_DEVICE_CREATION_STATIC=y
BR2_ROOTFS_OVERLAY="$(BR2_EXTERNAL)/board/rootfs_overlay"
BR2_LINUX_KERNEL=y
BR2_LINUX_KERNEL_CUSTOM_LOCAL=y
BR2_LINUX_KERNEL_CUSTOM_LOCAL_PATH="$(BR2_EXTERNAL)/../Ajit_linux_3.16.1"
BR2_LINUX_KERNEL_USE_CUSTOM_CONFIG=y
BR2_LINUX_KERNEL_CUSTOM_CONFIG_FILE="$(BR2_EXTERNAL)/board/Ajit_minimal_linux_kernel.config"
BR2_LINUX_KERNEL_VMLINUX=y
BR2_TARGET_ROOTFS_INITRAMFS=y
# BR2_TARGET_ROOTFS_TAR is not set
BR2_PACKAGE_HOST_E2FSPROGS=y
BR2_PACKAGE_HOST_GENEXT2FS=y
```

## os/Ajit_linux/Ajit_buildroot_configs/configs/Ajit_defconfig
```kconfig
# Architecture
BR2_sparc=y

# Build details
BR2_DEFCONFIG="$(CONFIG_DIR)/defconfig"
BR2_CCACHE=y
BR2_CCACHE_DIR="$(PWD)/.buildroot-ccache"

#GCC Optimization
BR2_OPTIMIZE_3=y

# Library
BR2_PREFER_STATIC_LIB=y

# Debugging
BR2_PACKAGE_HOST_GDB=y

# Rootfs and system packages details
BR2_ROOTFS_DEVICE_CREATION_STATIC=y
BR2_ROOTFS_OVERLAY="$(BR2_EXTERNAL)/board/rootfs_overlay"
BR2_TARGET_ROOTFS_INITRAMFS=y
BR2_PACKAGE_HOST_GENEXT2FS=y
# BR2_TARGET_ROOTFS_TAR is not set
BR2_PACKAGE_HOST_E2FSPROGS=y
BR2_LINUX_KERNEL_VMLINUX=y
BR2_PACKAGE_DHRYSTONE=y
BR2_PACKAGE_STRACE=y
BR2_PACKAGE_WHETSTONE=y


# Linux Kernel
BR2_LINUX_KERNEL=y
BR2_LINUX_KERNEL_CUSTOM_LOCAL=y
BR2_LINUX_KERNEL_CUSTOM_LOCAL_PATH="$(BR2_EXTERNAL)/../Ajit_linux_3.16.1"
BR2_LINUX_KERNEL_USE_CUSTOM_CONFIG=y
BR2_LINUX_KERNEL_CUSTOM_CONFIG_FILE="$(BR2_EXTERNAL)/board/Ajit_minimal_linux_kernel.config"
```

## os/Ajit_linux/Ajit_buildroot_configs/configs/Ajit_initramfs_1_defconfig
```kconfig
# config where libs are statically linked

BR2_sparc=y
BR2_DEFCONFIG="$(CONFIG_DIR)/defconfig"
BR2_OPTIMIZE_3=y
BR2_PREFER_STATIC_LIB=y
BR2_PACKAGE_HOST_GDB=y
BR2_TARGET_GENERIC_HOSTNAME="Ajit"
BR2_TARGET_GENERIC_ISSUE="Welcome to Ajit_linux"
BR2_ROOTFS_DEVICE_CREATION_STATIC=y
BR2_ROOTFS_OVERLAY="$(BR2_EXTERNAL)/board/overlay/initramfs"
BR2_LINUX_KERNEL=y
BR2_LINUX_KERNEL_CUSTOM_LOCAL=y
BR2_LINUX_KERNEL_CUSTOM_LOCAL_PATH="$(BR2_EXTERNAL)/../Ajit_linux_3.16.1"
BR2_LINUX_KERNEL_USE_CUSTOM_CONFIG=y
BR2_LINUX_KERNEL_CUSTOM_CONFIG_FILE="$(BR2_EXTERNAL)/board/Ajit_minimal_linux_kernel.config"
BR2_LINUX_KERNEL_VMLINUX=y
BR2_TARGET_ROOTFS_INITRAMFS=y
# BR2_TARGET_ROOTFS_TAR is not set
```

## os/Ajit_linux/Ajit_buildroot_configs/configs/Ajit_rootfs_0_defconfig
```kconfig
# Config that have dynamically linkked libs

BR2_sparc=y
BR2_DEFCONFIG="$(CONFIG_DIR)/defconfig"
BR2_OPTIMIZE_3=y
# BR2_PREFER_STATIC_LIB is not set
BR2_PACKAGE_HOST_GDB=y
BR2_TARGET_GENERIC_HOSTNAME="Ajit"
BR2_TARGET_GENERIC_ISSUE="Welcome to Ajit_linux"
BR2_ROOTFS_DEVICE_CREATION_STATIC=y
BR2_ROOTFS_OVERLAY="$(BR2_EXTERNAL)/board/overlay/rootfs"
BR2_PACKAGE_DHRYSTONE=y
BR2_PACKAGE_STRACE=y
BR2_PACKAGE_WHETSTONE=y
```

## os/Ajit_linux/Ajit_buildroot_configs/configs/archive/Ajit_initramfs_defconfig
```kconfig
BR2_sparc=y
BR2_DEFCONFIG="$(CONFIG_DIR)/defconfig"
BR2_CCACHE=y
BR2_CCACHE_DIR="$(PWD)/.buildroot-ccache"
BR2_TARGET_GENERIC_HOSTNAME="Ajit"
BR2_TARGET_GENERIC_ISSUE="Welcome to Ajit-linux"
BR2_ROOTFS_OVERLAY="$(PWD)/initramfs_overlay"
BR2_LINUX_KERNEL=y
BR2_LINUX_KERNEL_CUSTOM_LOCAL=y
BR2_LINUX_KERNEL_CUSTOM_LOCAL_PATH="$(BR2_EXTERNAL)/../Ajit_linux_3.16.1"
BR2_LINUX_KERNEL_USE_CUSTOM_CONFIG=y
BR2_LINUX_KERNEL_CUSTOM_CONFIG_FILE="$(BR2_EXTERNAL)/board/Ajit_minimal_linux_kernel.config"
BR2_LINUX_KERNEL_VMLINUX=y
BR2_TARGET_ROOTFS_INITRAMFS=y
# BR2_TARGET_ROOTFS_TAR is not set
```

## os/Ajit_linux/Ajit_buildroot_configs/configs/archive/Ajit_rootfs_defconfig
```kconfig
BR2_sparc=y
BR2_DEFCONFIG="$(CONFIG_DIR)/defconfig"
BR2_CCACHE=y
BR2_CCACHE_DIR="$(PWD)/.buildroot-ccache"
BR2_OPTIMIZE_3=y
BR2_ROOTFS_OVERLAY="$(PWD)/rootfs_overlay"
BR2_PACKAGE_DHRYSTONE=y
BR2_PACKAGE_WHETSTONE=y
```
